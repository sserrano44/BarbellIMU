## firmware/sdkconfig.defaults
```kconfig
# BLE Configuration
CONFIG_BT_ENABLED=y
CONFIG_BT_NIMBLE_ENABLED=y
CONFIG_BT_NIMBLE_MAX_CONNECTIONS=1
CONFIG_BT_NIMBLE_ROLE_CENTRAL=n
CONFIG_BT_NIMBLE_ROLE_OBSERVER=n
CONFIG_BT_NIMBLE_ROLE_BROADCASTER=y
CONFIG_BT_NIMBLE_ROLE_PERIPHERAL=y

# NimBLE tuning
CONFIG_BT_NIMBLE_ATT_PREFERRED_MTU=23

# I2C
CONFIG_I2C_ENABLE_DEBUG=n

# FreeRTOS
CONFIG_FREERTOS_HZ=1000

# Logging (can disable for production)
CONFIG_LOG_DEFAULT_LEVEL_INFO=y
```
